## tibbit_45/drivers/Kconfig
```kconfig
menu "Drivers"
    
    # rsource "display/ssd1963/Kconfig"
    # rsource "sensor/Kconfig"
endmenu
```

## tibbit_45/lib/Kconfig
```kconfig
menu "Custom libraries"

# rsource "custom/Kconfig"


rsource "socket_mgr/Kconfig"

rsource "udp_fwloader/Kconfig"

rsource "log_udp/Kconfig"


rsource "tibbit_45/Kconfig"

endmenu
```
